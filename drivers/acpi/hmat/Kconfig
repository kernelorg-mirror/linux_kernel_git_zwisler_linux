## drivers/acpi/hmat/Kconfig
```kconfig
config ACPI_HMAT
	bool "ACPI Heterogeneous Memory Attribute Table Support"
	depends on ACPI_NUMA
	depends on SYSFS
	help
	  Exports a sysfs representation of the ACPI Heterogeneous Memory
	  Attributes Table (HMAT).
```
